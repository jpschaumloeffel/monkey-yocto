## meta-monkey/conf/layer.conf
```bitbake
# We have a conf and classes directory, add to BBPATH
BBPATH .= ":${LAYERDIR}"

# We have recipes-* directories, add to BBFILES
BBFILES += "${LAYERDIR}/recipes-*/*/*.bb \
	${LAYERDIR}/recipes-*/*/*.bbappend"

BBFILE_COLLECTIONS += "monkey"
BBFILE_PATTERN_monkey = "^${LAYERDIR}/"
BBFILE_PRIORITY_monkey = "6"
```
